## config/boards/shields/cck-ball/Kconfig.defconfig
```kconfig
# Copyright (c) 2021 The ZMK Contributors
# SPDX-License-Identifier: MIT


if SHIELD_CCK-BALL_LEFT

config ZMK_KEYBOARD_NAME
    default "WK CCK-BALL"

config ZMK_SPLIT_ROLE_CENTRAL
    default y

endif


if SHIELD_CCK-BALL_LEFT || SHIELD_CCK-BALL_RIGHT

config ZMK_SPLIT
    default y

endif
```

## config/boards/shields/cck-ball/Kconfig.shield
```kconfig
# Copyright (c) 2021 The ZMK Contributors
# SPDX-License-Identifier: MIT

config SHIELD_CCK-BALL_LEFT
    def_bool $(shields_list_contains,cck-ball_left)

config SHIELD_CCK-BALL_RIGHT
    def_bool $(shields_list_contains,cck-ball_right)
```
